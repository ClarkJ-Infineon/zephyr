## dts/bindings/audio/ti,tlv320dac.yaml
```yaml
# Copyright (c) 2018, Intel Corporation
# SPDX-License-Identifier: Apache-2.0

description: Texas Instruments TLV320DAC310x Audio DAC

compatible: "ti,tlv320dac"

include: i2c-device.yaml

properties:
  reset-gpios:
    type: phandle-array
    description: |
      GPIO connected to the codec RESET pin. Optional: on boards where RESET is
      tied to a pull-up rather than a host GPIO, omit this property and the
      driver relies on the I2C software reset instead.

  use-volume-control-pin:
    type: boolean
    description: |
      Control the volume of the codec using the VOL/MICDET pin. This pin is
      shared with the microphone detection function, so it will not work if
      the microphone detection function is enabled.

  speaker-gain:
    type: int
    default: 6
    enum:
      - 6
      - 12
      - 18
      - 24
    description: |
      Sets the gain (in dB) of the speaker driver output stage.
      The reset value is 6dB.
```

## dts/bindings/pwm/infineon,tcpwm-pwm.yaml
```yaml
# SPDX-FileCopyrightText: Copyright (c) 2026 Infineon Technologies AG,
# SPDX-FileCopyrightText: or an affiliate of Infineon Technologies AG. All rights reserved.
#
# SPDX-License-Identifier: Apache-2.0

description: Infineon TCPWM PWM

compatible: "infineon,tcpwm-pwm"

include: [base.yaml, pwm-controller.yaml, pinctrl-device.yaml, "infineon,system-interrupts.yaml"]

properties:
  "#pwm-cells":
    const: 3
    description: |
      Number of items to expect in a PWM
      - channel of the timer used for PWM (not used)
      - period to set in ns
      - flags: standard flags like PWM_POLARITY_NORMAL

  pinctrl-0:
    description: |
      PORT pin configuration for the PWM signal.
      We expect that the phandles will reference pinctrl nodes. These
      nodes will have a nodelabel that matches the Infineon SoC Pinctrl
      defines and have following
      format: p<port>_<pin>_<peripheral inst>_<signal>.

      Examples:
        pinctrl-0 = <&p1_1_pwm0_0>;
    required: true

  pinctrl-names:
    required: true

  clocks:
    required: true
    description: |
      Peripheral clock divider feeding this TCPWM counter.

      The driver dereferences this unconditionally - PWM_PERI_CLOCK_INIT in
      pwm_infineon_tcpwm.c reads peri-group, div-type and channel straight
      off the phandle - so it has always been mandatory in practice. Leaving
      it undeclared here meant omitting it produced a wall of macro expansion
      errors from devicetree_generated.h rather than a diagnostic naming the
      missing property.

      The divider must belong to the same peripheral instance and group as
      the TCPWM block, which the block's clk-dst encodes. Several PWM
      channels may share one divider when they share a period.

      Example:
        clocks = <&peri0_group1_16bit_0>;

pwm-cells:
  - channel
  - period
  - flags
```
